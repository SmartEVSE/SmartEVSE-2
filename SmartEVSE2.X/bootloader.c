/*
;	 Project:       Smart EVSE
;    File:          bootloader.c
;    Date:          11 January 2020
;
; This code will overwrite v 1.05 of the bootloader with version 1.06
; Version 1.06 has much better protection against unintended flash writes/erases
;
;
; Permission is hereby granted, free of charge, to any person obtaining a copy
; of this software and associated documentation files (the "Software"), to deal
; in the Software without restriction, including without limitation the rights
; to use, copy, modify, merge, publish, distribute, sublicense, and/or sell
; copies of the Software, and to permit persons to whom the Software is
; furnished to do so, subject to the following conditions:
;
; The above copyright notice and this permission notice shall be included in
; all copies or substantial portions of the Software.
;
; THE SOFTWARE IS PROVIDED "AS IS", WITHOUT WARRANTY OF ANY KIND, EXPRESS OR
; IMPLIED, INCLUDING BUT NOT LIMITED TO THE WARRANTIES OF MERCHANTABILITY,
; FITNESS FOR A PARTICULAR PURPOSE AND NONINFRINGEMENT. IN NO EVENT SHALL THE
; AUTHORS OR COPYRIGHT HOLDERS BE LIABLE FOR ANY CLAIM, DAMAGES OR OTHER
; LIABILITY, WHETHER IN AN ACTION OF CONTRACT, TORT OR OTHERWISE, ARISING FROM,
; OUT OF OR IN CONNECTION WITH THE SOFTWARE OR THE USE OR OTHER DEALINGS IN
; THE SOFTWARE.
 */
#include <xc.h>
#include <string.h>
#include "bootloader.h"


const far unsigned char bootloader[] = {
	0x06, 0xD0, 0x0F, 0x01, 0x3A, 0x9F, 0xD0, 0xB2, 0x81, 0xBE, 0x7E, 0xEF, 0x7E, 0xF0, 0x55, 0x0E, 
	0x04, 0x6E, 0xAA, 0x0E, 0x05, 0x6E, 0x0F, 0x01, 0x3A, 0x9F, 0x20, 0xEE, 0x00, 0xF0, 0x00, 0x01, 
	0x81, 0xAE, 0xFE, 0xD7, 0x90, 0x0E, 0x71, 0x6E, 0x26, 0x0E, 0x72, 0x6E, 0x70, 0x86, 0x02, 0x0E, 
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	0xFF, 0xFF, 0xFF, 0xFF, 0xFF, 0xFF, 0xFF, 0xFF, 0xFF, 0xFF, 0xFF, 0xFF, 0xFF, 0xFF, 0xFF, 0xFF
};      


unsigned char checkbootloader(void) {
    unsigned int adr, i=0, cnt;
    unsigned char err=0, errcnt=0;
    
    INTCONbits.GIE = 0;                                                         // Disable interrupts
    
    EECON1 = 0x80;                                                              // Access Flash program memory
    TBLPTR = 0xFFD0;                                                            // Address unused by 1.05 bootloader, should be 0xff
    asm("TBLRD*+");
    if (TABLAT != 0xFF) {
        INTCONbits.GIE = 1;                                                     // Enable interrupts
        return 0;                                                               // already updated to 1.06 or higher
    }
       
    TBLPTR = 0xFFF0;                                                            // set to serial nr.
    asm("TBLRD*+");
    serialnr = TABLAT;                                                          // first read LSB
    asm("TBLRD*+");
    serialnr |= TABLAT<<8;                                                      // then MSB
   
    // now erase and overwrite the bootloader @ FD00-FFFF, 12 blocks of 64 bytes
    
    unlock55 = unlockMagic + 0x33;                                              // to protect against unintended flash writes/erase 
    unlockAA = unlockMagic + 0x88;                                              // we calculate the magic values
    
    do {
        i = 0;
        err = 0;
        adr = 0xFD00;
        do {
            memcpy(GLCDbuf, bootloader+i, 64);                                  // copy 64 bytes to temp buffer
            if (i == 0x2c0) {
                GLCDbuf[48] = serialnr & 0xff;
                GLCDbuf[49] = serialnr >> 8;
                GLCDbuf[50] = 0;
                GLCDbuf[51] = 0;
            }

            TBLPTR = adr;                                                       // set pointer to start of block to erase
            EECON1 = 0x94;                                                      // select erase, and set write enable     
            EECON2 = unlock55;
            EECON2 = unlockAA;                                                  // write magic values to enable erase
            EECON1bits.WR = 1;                                                  // start the actual erase

            TBLPTR = adr;                                                       // set pointer to start of block to erase         
            cnt = 0;
            do {
                TABLAT = GLCDbuf[i%64];                                         // No debug print here, as it will modify the TBLPTR
                i++;
                asm("TBLWT*+");                                                 // write to latch and increment
            } while (++cnt <64);

            asm("TBLRD*-");                                                     // dummy read to point to the correct flash block
            EECON1 = 0x84;                                                      // select flash write, and set write enable     
            EECON2 = unlock55;
            EECON2 = unlockAA;                                                  // write magic values to enable erase
            EECON1bits.WR = 1;                                                  // start the actual programming

            EECON1 = 0x80;                                                      // write disable
            TBLPTR = adr;
            i -=64;

            cnt = 0;
            do {
                asm("TBLRD*+");                                                 // read back flash
                if (TABLAT != GLCDbuf[i%64]) err = 1;                           // and verify with buffer
                i++;
            } while (++cnt <64);

            adr +=64;
        } while (adr);
    
    } while (err && ++errcnt < 3);                                              // try three times
    
    EECON1bits.WREN = 0;
    
    unlock55 = 0;
    unlockAA = 0;
    INTCONbits.GIE = 1;                                                         // Enable interrupts
    if (err) return 2;
    return 1;
}

